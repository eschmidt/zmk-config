## config/boards/Kconfig.defconfig
```kconfig
if ZMK_BACKLIGHT

config ZMK_BACKLIGHT
    select PWM
    select LED_PWM

config PWM
    default y

config LED_PWM
    default y

endif # ZMK_BACKLIGHT
```

## config/boards/arm/bingo/Kconfig.board
```kconfig
# nice!nano board configuration

# Copyright (c) 2020 Pete Johanson
# SPDX-License-Identifier: MIT

config BOARD_BINGO_LEFT
	bool "bingo_left"
	depends on SOC_NRF52840_QIAA

config BOARD_BINGO_RIGHT
	bool "bingo_right"
	depends on SOC_NRF52840_QIAA
```

## config/boards/arm/bingo/Kconfig.defconfig
```kconfig
# Copyright (c) 2021 The ZMK Contributors
# SPDX-License-Identifier: MIT

if BOARD_BINGO_LEFT

    config ZMK_KEYBOARD_NAME
    default "Bingo"

    config ZMK_SPLIT_BLE_ROLE_CENTRAL
    default y

endif # BOARD_BINGO_LEFT

if BOARD_BINGO_RIGHT

    config ZMK_KEYBOARD_NAME
    default "Bingo right"

endif # BOARD_BINGO_RIGHT

if BOARD_BINGO_LEFT || BOARD_BINGO_RIGHT || BOARD_NICE_NANO || BOARD_NICE_NANO_V2

    config BOARD
        default "bingo"

    config ZMK_SPLIT
        default y

    config ZMK_RGB_UNDERGLOW
    	select WS2812_STRIP
    	select SPI

    config ZMK_DISPLAY
        select LVGL_USE_CONT
        select LVGL_FONT_MONTSERRAT_26
        select LVGL_FONT_MONTSERRAT_20
        select LVGL_FONT_MONTSERRAT_16
        select LVGL_USE_LABEL
        select LVGL_USE_IMG

    if ZMK_DISPLAY

        choice ZMK_DISPLAY_STATUS_SCREEN
        	default ZMK_DISPLAY_STATUS_SCREEN_CUSTOM
        endchoice

        config SYSTEM_WORKQUEUE_STACK_SIZE
    		default 2048

        choice LVGL_THEME_DEFAULT_FONT_NORMAL
            default LVGL_THEME_DEFAULT_FONT_NORMAL_MONTSERRAT_26
        endchoice

        choice LVGL_THEME_DEFAULT_FONT_SMALL
            default LVGL_THEME_DEFAULT_FONT_SMALL_MONTSERRAT_16
        endchoice

        config SSD1306
            default y

        config I2C
            default y

        config SSD1306_REVERSE_MODE
            default y

    endif # ZMK_DISPLAY

    if LVGL

        config LVGL_VDB_SIZE
            default 64

        config LVGL_DPI
            default 148

        config LVGL_BITS_PER_PIXEL
            default 1

        choice LVGL_COLOR_DEPTH
            default LVGL_COLOR_DEPTH_1
        endchoice

    endif # LVGL

    if USB_DEVICE_STACK

        config USB_NRFX
            default y

    endif # USB_DEVICE_STACK

    config BT_CTLR
        default BT

    config ZMK_BLE
        default y

    config ZMK_USB
        default y

    config BONGO_CAT
        bool "WPM animation"
        depends on !ZMK_SPLIT || ZMK_SPLIT_ROLE_CENTRAL
        select LVGL_USE_IMG
        select LVGL_USE_ANIMATION
        select ZMK_WPM

    config BONGO_CAT_IDLE_LIMIT
        int "Upper limit for WPM for showing idle animation"
        default 30

    config          BONGO_CAT_SLOW_LIMIT
        int "Upper limit for WPM for showing slow typing image"
        default 60

endif # BOARD_BINGO_LEFT || BOARD_BINGO_RIGHT || BOARD_NICE_NANO || BOARD_NICE_NANO_V2
```

## config/boards/arm/nice_nano/Kconfig
```kconfig
# SPDX-License-Identifier: MIT

config BOARD_ENABLE_DCDC
	bool "Enable DCDC mode"
	select SOC_DCDC_NRF52X
	default y
	depends on (BOARD_NICE_NANO || BOARD_NICE_NANO_V2)

if ZMK_DISPLAY

config BONGO_CAT
    bool "Show WPM bongo cat"
    select ZMK_WPM
    select LVGL_USE_IMG
    select LVGL_USE_ANIMATION
    default y

if BONGO_CAT

config BONGO_CAT_IDLE_LIMIT
    int "Upper limit for WPM for showing idle animation"
    default 30

config BONGO_CAT_SLOW_LIMIT
    int "Upper limit for WPM for showing slow typing image"
    default 60

endif # BONGO_CAT


endif
```

## config/boards/arm/nice_nano/Kconfig.defconfig
```kconfig
# Copyright (c) 2021 The ZMK Contributors
# SPDX-License-Identifier: MIT

if BOARD_NICE_NANO || BOARD_NICE_NANO_V2

config BOARD
	default "nice_nano"

if USB_DEVICE_STACK

config USB_NRFX
	default y

endif # USB_DEVICE_STACK

config BT_CTLR
	default BT

config ZMK_BLE
	default y

config ZMK_USB
	default y

config ZMK_DISPLAY
	select LVGL_USE_CONT
	select LVGL_FONT_MONTSERRAT_26

choice ZMK_DISPLAY_STATUS_SCREEN
	default ZMK_DISPLAY_STATUS_SCREEN_CUSTOM

endchoice

if ZMK_DISPLAY

choice LVGL_THEME_DEFAULT_FONT_NORMAL
    default LVGL_THEME_DEFAULT_FONT_NORMAL_MONTSERRAT_26

endchoice

choice LVGL_THEME_DEFAULT_FONT_SMALL
    default LVGL_THEME_DEFAULT_FONT_SMALL_MONTSERRAT_26

endchoice


config LVGL_HOR_RES_MAX
	default 144

config LVGL_VER_RES_MAX
	default 168

config SPI
	default y

config LS0XX
	default y

config LVGL_BITS_PER_PIXEL
	default 1

choice LVGL_COLOR_DEPTH
	default LVGL_COLOR_DEPTH_1

endchoice

config LVGL_DPI
	default 30

config LVGL_VDB_SIZE
	default 16

endif # ZMK_DISPLAY

endif # BOARD_NICE_NANO || BOARD_NICE_NANO_V2
```

## config/boards/shields/splitkb_aurora_corne/Kconfig.defconfig
```kconfig
# Copyright (c) 2022 The ZMK Contributors
# SPDX-License-Identifier: MIT

if SHIELD_SPLITKB_AURORA_CORNE_LEFT

config ZMK_KEYBOARD_NAME
	default "Aurora Corne"

config ZMK_SPLIT_ROLE_CENTRAL
	default y

if ZMK_DISPLAY

choice ZMK_DISPLAY_STATUS_SCREEN
	default ZMK_DISPLAY_STATUS_SCREEN_CUSTOM

endchoice

config SYSTEM_WORKQUEUE_STACK_SIZE
    default 2048

choice LVGL_THEME_DEFAULT_FONT_NORMAL
    default LVGL_THEME_DEFAULT_FONT_NORMAL_MONTSERRAT_26

endchoice

choice LVGL_THEME_DEFAULT_FONT_SMALL
    default LVGL_THEME_DEFAULT_FONT_SMALL_MONTSERRAT_26

endchoice

config LVGL_HOR_RES_MAX
	default 144

config LVGL_VER_RES_MAX
	default 168

config BONGO_CAT
    bool "Show WPM bongo cat"
    select LVGL_USE_IMG
    select LVGL_USE_ANIMATION
    select ZMK_WPM
    default y

endif # ZMK_DISPLAY

endif # SHIELD_SPLITKB_AURORA_CORNE_LEFT


if SHIELD_SPLITKB_AURORA_CORNE_RIGHT

config DEF_RIGHT
    bool "use default display widgets on the right"
    select ZMK_WIDGET_BATTERY_STATUS
    select ZMK_WIDGET_BATTERY_STATUS_SHOW_PERCENTAGE
    default y

endif # SHIELD_SPLITKB_AURORA_CORNE_RIGHT


if SHIELD_SPLITKB_AURORA_CORNE_LEFT || SHIELD_SPLITKB_AURORA_CORNE_RIGHT

config ZMK_SPLIT
	default y

config ZMK_RGB_UNDERGLOW
	select WS2812_STRIP
	select SPI

config ZMK_DISPLAY
	select LVGL_USE_CONT
	select LVGL_FONT_MONTSERRAT_26

if ZMK_DISPLAY

config SSD1306
	default y

config I2C
	default y

config SSD1306_REVERSE_MODE
	default y

endif # ZMK_DISPLAY

if LVGL

config LVGL_VDB_SIZE
	default 64

config LVGL_DPI
	default 148

config LVGL_BITS_PER_PIXEL
	default 1

choice LVGL_COLOR_DEPTH
	default LVGL_COLOR_DEPTH_1
endchoice

endif # LVGL

endif # SHIELD_SPLITKB_AURORA_CORNE_LEFT || SHIELD_SPLITKB_AURORA_CORNE_RIGHT
```

## config/boards/shields/splitkb_aurora_corne/Kconfig.shield
```kconfig
# SPDX-License-Identifier: MIT

config SHIELD_SPLITKB_AURORA_CORNE_LEFT
	def_bool $(shields_list_contains,splitkb_aurora_corne_left)

config SHIELD_SPLITKB_AURORA_CORNE_RIGHT
	def_bool $(shields_list_contains,splitkb_aurora_corne_right)
	
menu "Bongo Cat Widget"

config BONGO_CAT
    bool "Show WPM bongo cat"
    select ZMK_WPM
    select LVGL_USE_IMG
    select LVGL_USE_ANIMATION

if BONGO_CAT

config BONGO_CAT_IDLE_LIMIT
    int "Upper limit for WPM for showing idle animation"
    default 30

config BONGO_CAT_SLOW_LIMIT
    int "Upper limit for WPM for showing slow typing image"
    default 60

endif # BONGO_CAT

endmenu
```
